## board/rit/nuc970/Kconfig
```kconfig
if (TARGET_NUC970_BT1001)

config SYS_BOARD
	default "nuc970"

config SYS_VENDOR
	default "rit"

config SYS_SOC
	default "nuc970"

config SYS_CONFIG_NAME
	default "nuc970_bt1001" if TARGET_NUC970_BT1001

config NUC970
	bool
	default y

endif
```

## board/rit/nuc980/Kconfig
```kconfig
if (TARGET_NUC980_D1001)

config SYS_BOARD
	default "nuc980"

config SYS_VENDOR
	default "rit"

config SYS_SOC
	default "nuc980"

config SYS_CONFIG_NAME
	default "nuc980_d1001" if TARGET_NUC980_D1001

config NUC980
	bool
	default y

endif
```

## configs/nuc980_d1001_defconfig
```kconfig
CONFIG_ARM=y
CONFIG_TARGET_NUC980_D1001=y
CONFIG_BOOTDELAY=3
CONFIG_SYS_CONSOLE_OVERWRITE_ROUTINE=y
CONFIG_SYS_NO_FLASH=y
CONFIG_HUSH_PARSER=y
# CONFIG_CMD_IMLS is not set
# CONFIG_CMD_FLASH is not set
CONFIG_CMD_SF=y
CONFIG_CMD_SPI=y
# CONFIG_CMD_FPGA is not set
# CONFIG_CMD_SETEXPR is not set
CONFIG_CMD_TIMER=y
CONFIG_CMD_UBI=y
CONFIG_SPI_FLASH=y
CONFIG_SPI_FLASH_BAR=y
CONFIG_SPI_NAND=y
CONFIG_SPI_FLASH_MTD=y
CONFIG_NUC980_CONSOLE=y
CONFIG_NUC980_SPI=y
CONFIG_USB=y
CONFIG_NUC980_WATCHDOG=y
CONFIG_OF_LIBFDT=y
CONFIG_SMBIOS_MANUFACTURER="nuvoton"
```
